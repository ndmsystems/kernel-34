## arch/mips/tc3262/Kconfig
```kconfig
if (RALINK_RT6XXX_MP || ECONET_EN75XX_MP)

config PCIE_PORT1
	bool "Second PCIe port support"
	default n

endif

#--------------------------

if (RALINK_RT63365 || ECONET_EN7512)

config TC3162_ADSL
	bool "Enable ADSL support"
	default n

endif

if ECONET_EN7512

config RALINK_VDSL
	bool "Enable VDSL support"
	default n

endif

#--------------------------

if MIPS_TC3262

config TC3262_IMEM
	bool "Enable SPRAM IMEM"
	default y

config TC3262_CPU_TIMER
	bool "Use CPU External Timer (per-VPE)"
	default y

endif

#--------------------------
```

## ndm/Kconfig
```kconfig
menu "NDM Systems options"

if !(RALINK_RT5350 || RALINK_MT7628)
menu "Ralink/MTK HW NAT"
source "ndm/Kconfig.ppe"
endmenu
endif
source "ndm/Kconfig.wifi"
source "ndm/Kconfig.usb"
source "ndm/Kconfig.crypto"
endmenu
```

## ndm/Kconfig.crypto
```kconfig
config  RALINK_HWCRYPTO
	depends on (RALINK_MT7621 || RALINK_RT6XXX_MP || ECONET_EN75XX_MP)
	tristate "HW Crypto Engine support"
	default m

config RALINK_HWCRYPTO_ESP6
	bool "Offload ESP6 via Crypto Engine"
	depends on RALINK_HWCRYPTO
	depends on IPV6
	default n
```

## ndm/Kconfig.usb
```kconfig
menu "MTK USB drivers"
config RT3XXX_EHCI_OHCI
    bool "Ralink USB2 EHCI/OHCI controller support"
    depends on (RALINK_RT3883 || RALINK_RT3352 || RALINK_RT5350 || RALINK_RT6XXX_MP || RALINK_MT7620 || RALINK_MT7628)
    select USB_ARCH_HAS_OHCI
    select USB_ARCH_HAS_EHCI

config MTK_XHCI
    bool "MediaTek USB3/USB2/USB1.1 xHCI controller support"
    depends on (RALINK_MT7621)
    select USB_ARCH_HAS_XHCI

endmenu
```

## ndm/Kconfig.wifi
```kconfig
menuconfig WIFI_DRIVER
	bool "Wi-Fi driver support"

if WIFI_DRIVER

choice
	prompt "Choose first Wi-Fi interface"

	config FIRST_IF_NONE
	bool "None"

	config FIRST_IF_RT2860
	bool "MT7620 with rt2860v2 driver (2.7.X.X)"
	depends on RALINK_MT7620
	select RTMP_MAC

	config FIRST_IF_MT7620
	bool "MT7620 with rlt_wifi driver (3.0.X.X)"
	depends on RALINK_MT7620
	select RTMP_MAC
	select RALINK_RT6352

	config FIRST_IF_MT7628
	bool "MT7628/MT7688"
	depends on RALINK_MT7628
	select MT_MAC

	config FIRST_IF_RT5392
	bool "RT5392"
	depends on RALINK_RT6XXX_MP
	select RTMP_MAC
	select RALINK_RT5392

	config FIRST_IF_MT7602E
	bool "MT7602E"
	depends on RALINK_MT7621
	select RLT_MAC
	select RALINK_MT7612E

	config FIRST_IF_MT7603E
	bool "MT7603E"
	depends on RALINK_MT7621
	select MT_MAC
	select WIFI_MT_MAC
	select CHIP_MT7603E

	config FIRST_IF_MT7615E
	bool "MT7615E"
	depends on RALINK_MT7621
	select MT_MAC
	select WIFI_MT_MAC
	select CHIP_MT7615E
endchoice

choice
	prompt "EEPROM type of 1st card"
	depends on ! FIRST_IF_NONE

	config FIRST_IF_EEPROM_PROM
	bool "EEPROM"

	config FIRST_IF_EEPROM_EFUSE
	bool "EFUSE"

	config FIRST_IF_EEPROM_FLASH
	bool "FLASH"
endchoice

choice
	prompt "PA & LNA type of 1st card"
	depends on FIRST_IF_MT7615E

	config FIRST_IF_EPAELNA
	bool "ePA/eLNA"

	config FIRST_IF_IPAILNA
	bool "iPA/iLNA"

	config FIRST_IF_IPAELNA
	bool "iPA/eLNA"
endchoice

choice
	prompt "Choose second Wi-Fi interface"

	config SECOND_IF_NONE
	bool "None"

	config SECOND_IF_RT3593
	bool "RT3593 PCIe"
	select RTMP_MAC
	select RALINK_RT3593

	config SECOND_IF_RT5592
	bool "RT5592"
	select RTMP_MAC
	select RALINK_RT5592

	config SECOND_IF_MT7612E
	bool "MT7612E"
	select RLT_MAC
	select RALINK_MT7612E

	config SECOND_IF_MT7615E
	bool "MT7615E"
	select MT_MAC
	select WIFI_MT_MAC
	select CHIP_MT7615E
endchoice

choice
	prompt "EEPROM type of 2nd card"
	depends on ! SECOND_IF_NONE

	config SECOND_IF_EEPROM_PROM
	bool "EEPROM"

	config SECOND_IF_EEPROM_EFUSE
	bool "EFUSE"

	config SECOND_IF_EEPROM_FLASH
	bool "FLASH"
endchoice

choice
	prompt "PA & LNA type of 2nd card"
	depends on SECOND_IF_MT7615E

	config SECOND_IF_EPAELNA
	bool "ePA/eLNA"

	config SECOND_IF_IPAILNA
	bool "iPA/iLNA"

	config SECOND_IF_IPAELNA
	bool "iPA/eLNA"
endchoice

config RT_FIRST_CARD
	int
	depends on ! FIRST_IF_NONE
	default 2860 if FIRST_IF_RT2860
	default 7620 if FIRST_IF_MT7620
	default 7628 if FIRST_IF_MT7628
	default 5392 if FIRST_IF_RT5392
	default 7602 if FIRST_IF_MT7602E
	default 7603 if FIRST_IF_MT7603E
	default 7615 if FIRST_IF_MT7615E

config RT_SECOND_CARD
	int
	depends on ! SECOND_IF_NONE
	default 3593 if SECOND_IF_RT3593
	default 5592 if SECOND_IF_RT5592
	default 7612 if SECOND_IF_MT7612E
	default 7615 if SECOND_IF_MT7615E

config RT_FIRST_IF_RF_OFFSET
	hex
	depends on ! FIRST_IF_NONE
	default 0x0

config RT_SECOND_IF_RF_OFFSET
	hex
	depends on ! SECOND_IF_NONE
	default 0x8000

config RT_FIRST_CARD_EEPROM
	string
	depends on ! FIRST_IF_NONE
	default "prom" if FIRST_IF_EEPROM_PROM
	default "efuse" if FIRST_IF_EEPROM_EFUSE
	default "flash" if FIRST_IF_EEPROM_FLASH

config RT_SECOND_CARD_EEPROM
	string
	depends on ! SECOND_IF_NONE
	default "prom" if SECOND_IF_EEPROM_PROM
	default "efuse" if SECOND_IF_EEPROM_EFUSE
	default "flash" if SECOND_IF_EEPROM_FLASH

config RTMP_MAC
	bool

config RLT_MAC
	bool

config MT_MAC
	bool

config RTMP_RBUS_SUPPORT
	bool

config RTMP_PCI_SUPPORT
	bool

config RTMP_USB_SUPPORT
	bool

config MULTI_INF_SUPPORT
	bool
	default y if (RTMP_RBUS_SUPPORT && RTMP_PCI_SUPPORT)

config RALINK_RT6352
	bool
	select RTMP_RBUS_SUPPORT

config RALINK_MT7612E
	bool
	select RTMP_PCI_SUPPORT

config CHIP_MT7615E
	bool
	select RTMP_PCI_SUPPORT

if (RALINK_MT7620)
menu "Ralink MT7620 RBUS Wireless driver (rt2860v2)"
source "ndm/rt2860v2_ap/Kconfig"
endmenu
endif

if (RALINK_MT7628)
menu "MediaTek MT7628/MT7688 RBUS Wireless driver"
source "ndm/mt7628_ap/Kconfig"
source "ndm/mt7628/Kconfig"
endmenu
endif

menu "MediaTek MT7620/MT7602E/MT7612E RBUS/PCIe Wireless driver"
source "ndm/mt76x2_ap/Kconfig"
source "ndm/mt76x2/Kconfig"
endmenu

#menu "MediaTek MT7603E PCIe Wireless driver"
#source "ndm/mt7603_ap/Kconfig"
#source "ndm/mt7603/Kconfig"
#endmenu

menu "MediaTek MT7615E PCIe Wireless driver"
source "ndm/mt7615_ap/Kconfig"
source "ndm/mt7615/Kconfig"
endmenu

menu "Ralink RT5392E PCIe Wireless driver"
source "ndm/rt5392_ap/Kconfig"
endmenu

menu "Ralink RT3593E PCIe Wireless driver"
source "ndm/rt3593_ap/Kconfig"
endmenu

menu "Ralink RT5592E PCIe Wireless driver"
source "ndm/rt5592_ap/Kconfig"
endmenu

menu "Common Wi-Fi settings"
config ATE_SUPPORT
	bool "ATE/QA Support"
	default n

config WIFI_DEBUG_SUPPORT
	bool "Debug Mode Support"
	default n

config WIFI_MEMORY_OPTIMIZATION
	bool "Memory Optimization (< 32MB RAM)"
	default n

config WIFI_SKB_RECYCLE
	bool "SKB Recycle (Linux)"
	default n

config WIFI_WORK_QUEUE
	bool "Use BH Workqueue (instead of Tasklets)"
	default n

#config WIFI_PKT_FWD
#	bool "WiFi packet forwarding"
#	default n

#source "drivers/net/wireless/wifi_forward/wifi_fwd/Kconfig"
endmenu

endif # WIFI_DRIVER

config RTDEV
	bool
	default y if WIFI_DRIVER && !SECOND_IF_NONE || RTDEV_MII
	default y if RTDEV_PLC
```

## ndm/mt7615_ap/Kconfig
```kconfig
config MT7615_AP
	tristate "MT7615E 802.11ac AP support"
	select WIRELESS_EXT
	select WEXT_SPY
	select WEXT_PRIV

if MT7615_AP

config MT7615_MBSS_SUPPORT
	bool "MBSSID support"
	default y

config MT7615_WDS_SUPPORT
	bool "WDS support"
	default n

config MT7615_APCLI_SUPPORT
	bool "AP-Client support"
	default y

config MT7615_APCLI_CERT_SUPPORT
	bool "AP-Client TGN Cert support"
	depends on MT7615_APCLI_SUPPORT
	default n

config MT7615_MAC_REPEATER_SUPPORT
	bool "MAC Repeater support"
	depends on MT7615_APCLI_SUPPORT
	default n

config MT7615_CON_WPS_SUPPORT
	bool "Concurrent WPS support"
	depends on MT7615_APCLI_SUPPORT
	depends on MT7615_WSC_INCLUDED
	depends on MT7615_WSC_V2_SUPPORT
	default n

config MT7615_PASSPOINT_R2
	bool "Passpoint Release-2 support"
	select MT7615_DOT11W_PMF_SUPPORT
	default n

#config MT7615_AIRPLAY_SUPPORT
#	bool "AirPlay support"
#	default n

config MT7615_VOW_SUPPORT
	bool "MediaAir (VOW) support"
	default n

config MT7615_RED_SUPPORT
	bool "RED (Random Early Drop) support"
	default n

config MT7615_DSCP_QOS_MAP_SUPPORT
	bool "DSCP Qos Mapping Support"
	default n

config MT7615_BAND_STEERING
	bool "Band Steering support"
	default n

#config MT7615_LLTD_SUPPORT
#	bool "LLTD (Link Layer Topology Discovery Protocol) support"
#	default n

#config MT7615_IDS_SUPPORT
#	bool "IDS (Intrusion Detection System) support"
#	default n

config MT7615_GREENAP_SUPPORT
	bool "GreenAP support"
	default n

config MT7615_IGMP_SNOOP_SUPPORT
	bool "IGMP Snooping support"
	default y

config MT7615_MCAST_RATE_SPECIFIC
	bool "User Specific Tx Rate of MCAST Packet"
	default n

config MT7615_RADIUS_ACCOUNTING_SUPPORT
	bool "Radius Accounting support"
	default n

config MT7615_ICAP_SUPPORT
	bool "Internal Capture support"
	default n

endif # MT7615_AP
```

## ndm/mt7628_ap/Kconfig
```kconfig
menu "MTK Wi-Fi driver for MT7628"

config MT7628_AP
	tristate "MT7628 SoC 802.11n AP support"

config MT_AP_SUPPORT
	bool
	default y
	depends on MT7628_AP

config NEW_RATE_ADAPT_SUPPORT
	bool "New adaption rate"
	default y
	depends on MT7628_AP

config AGS_SUPPORT
	bool "AGS support"
	default n
	depends on NEW_RATE_ADAPT_SUPPORT

config MT_MAC
	bool
	default y
	depends on MT7628_AP

config UAPSD
	bool "Unscheduled automatic power save delivery"
	default y
	depends on MT7628_AP

config SMART_CARRIER_SENSE_SUPPORT
	bool "Smart Carrier Sense"
	depends on MT7628_AP
	default y

config WSC_INCLUDED
	bool "WSC"
	default y
	depends on MT7628_AP

config WSC_V2_SUPPORT
	bool "WSC V2"
	depends on WSC_INCLUDED
	default y

config WMM_ACM_SUPPORT
	bool "WMM ACM"
	default n
	depends on MT7628_AP

config DOT11W_PMF_SUPPORT
	bool "802.11w PMF support"
	default y
	depends on MT7628_AP

config LLTD_SUPPORT
	bool "Link layer topology discovery"
	default n
	depends on MT7628_AP

config PASSPOINT_R2
	bool "Pass point R2"
	default n
	depends on MT7628_AP

config SNIFFER_SUPPORT
	bool "Sniffer support"
	default n
	depends on MT7628_AP

config IGMP_SNOOP_SUPPORT
	bool "IGMP snooping"
	default y
	depends on MT7628_AP

config BLOCK_NET_IF
	bool "Block a network interface while a TX queue is full"
	default n
	depends on MT7628_AP

config SINGLE_SKU
	bool "Single SKU V2"
	default n
	depends on MT7628_AP

config LED_CONTROL_SUPPORT
	bool "LED control"
	default y
	depends on MT7628_AP

config QOS_DLS_SUPPORT
	bool "QoS DLS"
	default n
	depends on MT7628_AP

config MBSS_SUPPORT
	bool "MBSS support"
	default y
	depends on MT7628_AP

config NEW_MBSSID_MODE
	bool "New MBSSID mode"
	default y
	depends on MBSS_SUPPORT

config ENHANCE_NEW_MBSSID_MODE
	bool "Enchance new MBSSID mode"
	default y
	depends on NEW_MBSSID_MODE

config APCLI_SUPPORT
	bool "ApCli support"
	default y
	depends on MT7628_AP

config MAC_REPEATER_SUPPORT
	bool "MAC repeater support"
	default n
	depends on APCLI_SUPPORT

config IDS_SUPPORT
	bool "Intrusion detection system"
	default n
	depends on MT7628_AP

config ATE_SUPPORT
	bool "ATE support"
	default n
	depends on MT7628_AP

config WIFI_DEBUG_SUPPORT
	bool "Debug mode support"
	default n
	depends on MT7628_AP

config MEMORY_OPTIMIZATION
	bool "Enable memory optimization"
	default y
	depends on MT7628_AP

config RTMP_FLASH_SUPPORT
	bool "RTMP flash support"
	default y
	depends on MT7628_AP

config RTMP_EFUSE_SUPPORT
	bool "RTMP eFUSE support"
	default n
	depends on MT7628_AP

config RTMP_TEMPERATURE_TX_ALC
	bool "Temperature TX ALC"
	default n
	depends on MT7628_AP

config RTMP_INTERNAL_TX_ALC
	bool "Internal TX ALC"
	default n
	depends on MT7628_AP

endmenu
```
